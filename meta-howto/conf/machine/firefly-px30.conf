## meta-howto/conf/machine/firefly-px30.conf
```bitbake
#@TYPE: Machine
#@NAME: FIREFLY PX30

require conf/machine/include/px30.inc


RK_KERNEL_DEVICETREE_PREFIX = "rockchip/"
RK_KERNEL_DEVICETREE = "firefly-px30.dtb"

KERNEL_DEVICETREE = "${RK_KERNEL_DEVICETREE_PREFIX}${RK_KERNEL_DEVICETREE}"
UBOOT_MACHINE = "firefly-px30_defconfig"

SERIAL_CONSOLES = "115200;ttyS2"

WKS_FILE = "px30.wks"
WKS_FILE_DEPENDS += "rockchip-loader"

IMAGE_BOOT_FILES:remove = " ${KERNEL_DEVICETREE}"
IMAGE_BOOT_FILES:append = " ${RK_KERNEL_DEVICETREE}"

KERNEL_IMAGETYPE = "Image"

KERNEL_CLASSES = ""
```

## meta-howto/conf/machine/xa-rockchip-px30-evb.conf
```bitbake
#@TYPE: Machine
#@NAME: PX30 EVB


SOC_FAMILY = "px30"

DEFAULTTUNE ?= "cortexa35-crypto"

require conf/machine/include/soc-family.inc
require conf/machine/include/arm/armv8a/tune-cortexa35.inc
require conf/machine/include/rockchip-defaults.inc
require conf/machine/include/rockchip-wic.inc

KBUILD_DEFCONFIG ?= "defconfig"

TFA_PLATFORM = "px30"
TFA_BUILD_TARGET = "bl31"

UBOOT_SUFFIX ?= "itb"
UBOOT_ENTRYPOINT ?= "0x06000000"

SERIAL_CONSOLES = "115200;ttyS2"

# SPL_BINARY = "u-boot-rockchip.bin"

RK_KERNEL_DEVICETREE = "px30-evb.dtb"
RK_KERNEL_DEVICETREE_PREFIX = "rockchip/"

KERNEL_DEVICETREE = "${RK_KERNEL_DEVICETREE_PREFIX}${RK_KERNEL_DEVICETREE}"
UBOOT_MACHINE = "evb-px30_defconfig"

WKS_FILE = "px30.wks"
WKS_FILE_DEPENDS += "rockchip-loader"

IMAGE_BOOT_FILES:remove = " ${KERNEL_DEVICETREE}"
IMAGE_BOOT_FILES:append = " ${RK_KERNEL_DEVICETREE}"

KERNEL_IMAGETYPE = "Image"
```

## meta-howto/wic/px30.wks
```
#   Partition   Start Sector    Number of Sectors
#   loader1     64              8000
#   reserved1   8064            128
#   reserved2   8192            8192
#   loader2     16384           8192
#   atf         24576           8192
#   boot        32768           229376
#   rootfs      262144          -


part loader1    --label loader1    --offset 64s     --fixed-size 4000K      --source rawcopy            --fstype=none   --sourceparams="file=px30_loader_uboot.bin"
part reserved1  --label reserved1  --offset 8064s   --fixed-size 64K                                    --fstype=none
part reserved2  --label reserved2  --offset 8192s   --fixed-size 4096K                                  --fstype=none
part loader2    --label loader2    --offset 16384s  --fixed-size 4096K      --source rawcopy            --fstype=none   --sourceparams="file=u-boot.${UBOOT_SUFFIX}"
part atf        --label atf        --offset 24576s  --fixed-size 4096K                                  --fstype=none
part /boot      --label boot       --offset 32768s  --size 114688K          --source bootimg-partition  --fstype=vfat   --active
part /          --label rootfs                                              --source rootfs             --fstype=ext4

bootloader --ptable gpt
```
